## Config.in
```kconfig
config BR2_PACKAGE_GST_AML_DRMBUFFERPOOL1
	bool "gst-aml-drmbufferpool1"
        depends on BR2_PACKAGE_GSTREAMER1
        depends on BR2_PACKAGE_GST1_PLUGINS_BASE
        depends on BR2_PACKAGE_LIBDRM
        help
          Amlogic GStreamer1 DRM Bufferpool 1.0
```
